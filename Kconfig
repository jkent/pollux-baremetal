## Kconfig
```kconfig
mainmenu "POLLUX Baremetal Configuration"

choice BAREMETAL_BOOT_SOURCE
	prompt "Boot source"
config BAREMETAL_BOOT_SOURCE_RAM
	bool "RAM"
config BAREMETAL_BOOT_SOURCE_UART
	bool "UART boot"
config BAREMETAL_BOOT_SOURCE_NAND
	bool "NAND flash"
config BAREMETAL_BOOT_SOURCE_NOR
	bool "NOR flash"
	depends on HAVE_NOR
	depends on NOT_IMPLEMENTED
endchoice

choice BAREMETAL_NAND_PAGE_SIZE
	prompt "NAND page size" if BAREMETAL_BOOT_SOURCE_NAND
	default BAREMETAL_NAND_PAGE_SIZE_2048
config BAREMETAL_NAND_PAGE_SIZE_512
	bool "512 B"
config BAREMETAL_NAND_PAGE_SIZE_2048
	bool "2 KiB"
endchoice

config BAREMETAL_NAND_PAGE_SIZE
	int
	default 512 if BAREMETAL_NAND_PAGE_SIZE_512
	default 2048 if BAREMETAL_NAND_PAGE_SIZE_2048

choice BAREMETAL_RAM_SIZE
	prompt "RAM size"
config BAREMETAL_RAM_SIZE_16
	bool "16 MiB"
config BAREMETAL_RAM_SIZE_32
	bool "32 MiB"
config BAREMETAL_RAM_SIZE_64
	bool "64 MiB"
config BAREMETAL_RAM_SIZE_128
	bool "128 MiB"
endchoice

config BAREMETAL_RAM_SIZE
	hex
	default 0x1000000 if BAREMETAL_RAM_SIZE_16
	default 0x2000000 if BAREMETAL_RAM_SIZE_32
	default 0x4000000 if BAREMETAL_RAM_SIZE_64
	default 0x8000000 if BAREMETAL_RAM_SIZE_128

menuconfig BAREMETAL_LINKER_SCRIPT
	bool "Use baremetal linker script"
	default y

if BAREMETAL_LINKER_SCRIPT
config BAREMETAL_SHADOW
	bool "Shadow RAM" if BAREMETAL_BOOT_SOURCE_RAM
	default y if BAREMETAL_BOOT_SOURCE_RAM
	default y if BAREMETAL_BOOT_SOURCE_UART
	default y if BAREMETAL_BOOT_SOURCE_NAND
	help
	  If enabled, DDR (MCU-Y) starts at physical address 0x00000000 and
	  the static bus (MCU-S) starts at 0x80000000.  Otherwise these two
	  1GB memory spaces are reversed.  Ususally you want this enabled.

config BAREMETAL_RUNTIME_ADDRESS
	hex "Runtime address"
	default 0x00000000 if BAREMETAL_SHADOW
	default 0x80000000 if !BAREMETAL_SHADOW
	range 0x00000000 0x07FFFFFF if BAREMETAL_SHADOW
	range 0x80000000 0x87FFFFFF if !BAREMETAL_SHADOW
endif

config BAREMETAL_ENTRY
menuconfig BAREMETAL_ENTRY
	bool "Use baremetal entry code"
	default y

if BAREMETAL_ENTRY
config BAREMETAL_AUTO_RELOCATE
	bool "Auto relocate"
	default y

config BAREMETAL_LATCH_POWER
	bool "Latch power"
	default y
	help
	  Say Y here to enable latching power in startup code.
endif

config BAREMETAL_STARTUP
menuconfig BAREMETAL_STARTUP
	depends on BAREMETAL_ENTRY
	bool "Use baremetal startup code"
	default y

if BAREMETAL_STARTUP
config BAREMETAL_NEWLIB
	bool "Use Newlib"
	default y

config BAREMETAL_FREERTOS
config BAREMETAL_FREERTOS
	#depends on BAREMETAL_NEWLIB
	bool "Use FreeRTOS"
	default y

config BAREMETAL_EXCEPTION
	bool "Setup exceptions"
	default y

config BAREMETAL_FIQ_STACK_SIZE
	depends on BAREMETAL_EXCEPTION
	hex "FIQ mode stack size"
	default 0x1000

config BAREMETAL_IRQ_STACK_SIZE
	depends on BAREMETAL_EXCEPTION
	hex "IRQ mode stack size"
	default 0x1000

config BAREMETAL_ABT_STACK_SIZE
	depends on BAREMETAL_EXCEPTION
	hex "ABT (abort) mode stack size"
	default 0x1000

config BAREMETAL_UND_STACK_SIZE
	depends on BAREMETAL_EXCEPTION
	hex "UND (undefined) mode stack size"
	default 0x1000

config BAREMETAL_MMU
	bool "Enable MMU"
	default y
	help
	  Say Y here to enable the MMU, setup with a basic 1:1 mmemory map.

config BAREMETAL_DCACHE
config BAREMETAL_DCACHE
	depends on BAREMETAL_MMU
	bool "Enable DCache"
	default y
	help
	  Say Y here to enable the data cache.

config BAREMETAL_ICACHE
	bool "Enable ICache"
	default y
	help
	  Say Y here to enable the instruction cache.  In almost all
	  circumstances you want this.

choice BAREMETAL_PLL0_INIT
	prompt "Initialize PLL0"
	default BAREMETAL_PLL0_INIT_533
	depends on BAREMETAL_ICACHE
	help
	  PLL0 is the clock source for the ARM9 CPU. It is initially 384 MHz.
config BAREMETAL_PLL0_INIT_NONE
	bool "No"
config BAREMETAL_PLL0_INIT_533
	bool "533 MHz"
endchoice

choice BAREMETAL_PLL1_INIT
	prompt "Initialize PLL1"
	default BAREMETAL_PLL1_INIT_120
	help
	  PLL1 is the clock source for periperhals.  It is initially 147.461538 MHz.
config BAREMETAL_PLL1_INIT_NONE
	bool "No"
config BAREMETAL_PLL1_INIT_120
	bool "120 MHz"
endchoice

config BAREMETAL_DDR_INIT
	bool "Initialize DDR"
	default y

choice BAREMETAL_UART
	prompt "UART implementation"
	default BAREMETAL_UART_FIFO if BAREMETAL_EXCEPTION
	default BAREMETAL_UART_POLLED if !BAREMETAL_EXCEPTION
config BAREMETAL_UART_NONE
	bool "None"
config BAREMETAL_UART_POLLED
	bool "Polled"
	depends on NOT_IMPLEMENTED
config BAREMETAL_UART_FIFO
	bool "FIFO"
	depends on NOT_IMPLEMENTED
	depends on BAREMETAL_EXCEPTION
endchoice
endif
```

## examples/empty/defconfig
```kconfig
#
# Baremetal: startup
#
CONFIG_BAREMETAL_BOOT_SOURCE_UART=y
CONFIG_BAREMETAL_SHADOW=y
CONFIG_BAREMETAL_INITIAL_STACK_SIZE=0x40000
CONFIG_BAREMETAL_ENTRY_ADDRESS=0x00000000
CONFIG_BAREMETAL_RELOCATE=y
CONFIG_BAREMETAL_RELOCATE_ADDRESS=0x00800000
CONFIG_BAREMETAL_LATCH_POWER=y
# end of Baremetal: startup

#
# Baremetal: runtime
#
# CONFIG_BAREMETAL_ENABLE_ICACHE is not set
# CONFIG_BAREMETAL_DDR_INIT is not set
# CONFIG_BAREMETAL_USE_NEWLIB is not set
CONFIG_BAREMETAL_HEAP_NONE=y
# CONFIG_BAREMETAL_HEAP_FIXED is not set
# CONFIG_BAREMETAL_HEAP_AUTO is not set
# CONFIG_BAREMETAL_MOVE_STACK is not set
CONFIG_BAREMETAL_UART_NONE=y
# end of Baremetal: runtime
```

## examples/freertos-demo/defconfig
```kconfig
# CONFIG_BAREMETAL_BOOT_SOURCE_RAM is not set
CONFIG_BAREMETAL_BOOT_SOURCE_UART=y
# CONFIG_BAREMETAL_BOOT_SOURCE_NAND is not set
CONFIG_BAREMETAL_RAM_SIZE_16=y
# CONFIG_BAREMETAL_RAM_SIZE_32 is not set
# CONFIG_BAREMETAL_RAM_SIZE_64 is not set
# CONFIG_BAREMETAL_RAM_SIZE_128 is not set
CONFIG_BAREMETAL_RAM_SIZE=0x1000000
CONFIG_BAREMETAL_SHADOW=y
CONFIG_BAREMETAL_RUNTIME_ADDRESS=0x00800000
CONFIG_BAREMETAL_AUTO_RELOCATE=y

#
# Startup options
#
CONFIG_BAREMETAL_NEWLIB=y
CONFIG_BAREMETAL_FREERTOS=y
CONFIG_BAREMETAL_STARTUP_DEBUG=y
CONFIG_BAREMETAL_EXCEPTION=y
CONFIG_BAREMETAL_FIQ_STACK_SIZE=0x1000
CONFIG_BAREMETAL_IRQ_STACK_SIZE=0x1000
CONFIG_BAREMETAL_ABT_STACK_SIZE=0x1000
CONFIG_BAREMETAL_UND_STACK_SIZE=0x1000
# CONFIG_BAREMETAL_MMU is not set
# CONFIG_BAREMETAL_ICACHE is not set
CONFIG_BAREMETAL_PLL1_INIT_NONE=y
# CONFIG_BAREMETAL_PLL1_INIT_120 is not set
# CONFIG_BAREMETAL_DDR_INIT is not set
CONFIG_BAREMETAL_UART_NONE=y
# end of Startup options
```

## examples/hello-world/defconfig
```kconfig
# CONFIG_BAREMETAL_BOOT_SOURCE_RAM is not set
CONFIG_BAREMETAL_BOOT_SOURCE_UART=y
CONFIG_BAREMETAL_RAM_SIZE_16=y
# CONFIG_BAREMETAL_RAM_SIZE_32 is not set
# CONFIG_BAREMETAL_RAM_SIZE_64 is not set
# CONFIG_BAREMETAL_RAM_SIZE_128 is not set
CONFIG_BAREMETAL_RAM_SIZE=0x1000000
CONFIG_BAREMETAL_SHADOW=y
CONFIG_BAREMETAL_RUNTIME_ADDRESS=0x00000000
CONFIG_BAREMETAL_AUTO_RELOCATE=y

#
# Startup options
#
CONFIG_BAREMETAL_NEWLIB=y
# CONFIG_BAREMETAL_FREERTOS is not set
CONFIG_BAREMETAL_STARTUP_DEBUG=y
# CONFIG_BAREMETAL_EXCEPTION is not set
# CONFIG_BAREMETAL_MMU is not set
# CONFIG_BAREMETAL_ICACHE is not set
CONFIG_BAREMETAL_PLL1_INIT_NONE=y
# CONFIG_BAREMETAL_PLL1_INIT_120 is not set
# CONFIG_BAREMETAL_DDR_INIT is not set
CONFIG_BAREMETAL_UART_NONE=y
# end of Startup options
```
